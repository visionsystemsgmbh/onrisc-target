## baltos/image/Config.in
```kconfig
menuconfig TARGET_ROOTFS_INCLUDE_KERNEL
	bool "Include kernel in root filesystem"
	depends on TARGET_ROOTFS_UBIFS || TARGET_ROOTFS_EXT4FS
	default n
	help
	  Include the kernel image in the rootfs. Typically, the image is placed
	  below /boot.

	config TARGET_ROOTFS_INCLUDE_UIMAGE
		bool "include uImage" if TARGET_ROOTFS_INCLUDE_KERNEL
		default y
		help
		  This option might not apply to all targets. Make sure
		  to check target/linux/<your_target>/image/Makefile to
		  see if this option will have any effect.

	config TARGET_ROOTFS_INCLUDE_ZIMAGE
		bool "include zImage" if TARGET_ROOTFS_INCLUDE_KERNEL
		default y
		help
		  This option might not apply to all targets. Make sure
		  to check target/linux/<your_target>/image/Makefile to
		  see if this option will have any effect.

	config TARGET_ROOTFS_INCLUDE_FIT
		bool "include FIT" if TARGET_ROOTFS_INCLUDE_KERNEL
		default y
		help
		  This option might not apply to all targets. Make sure
		  to check target/linux/<your_target>/image/Makefile to
		  see if this option will have any effect.
```
